## techpack/Kconfig.ext
```kconfig
# Techpack Kconfig
source "techpack/camera/Kconfig"
source "techpack/bt-kernel/btfmcodec/Kconfig"
source "techpack/bt-kernel/pwr/Kconfig"
source "techpack/bt-kernel/rtc6226/Kconfig"
source "techpack/bt-kernel/slimbus/Kconfig"
source "techpack/bt-kernel/soundwire/Kconfig"
source "techpack/dataipa/config/Kconfig"
source "techpack/datarmnet-ext/aps/Kconfig"
source "techpack/datarmnet-ext/mem/Kconfig"
source "techpack/datarmnet-ext/offload/Kconfig"
source "techpack/datarmnet-ext/perf/Kconfig"
source "techpack/datarmnet-ext/perf_tether/Kconfig"
source "techpack/datarmnet-ext/sch/Kconfig"
source "techpack/datarmnet-ext/shs/Kconfig"
source "techpack/datarmnet-ext/wlan/Kconfig"
source "techpack/datarmnet/core/Kconfig"
source "techpack/graphics/Kconfig"
source "techpack/mm-drivers/hw_fence/Kconfig"
source "techpack/mm-drivers/msm_ext_display/Kconfig"
source "techpack/mm-drivers/sync_fence/Kconfig"
source "techpack/nxp-nfc/Kconfig"
source "techpack/eSE/Kconfig"
source "techpack/wlan/platform/cnss2/Kconfig"
source "techpack/wlan/platform/cnss_genl/Kconfig"
source "techpack/wlan/platform/cnss_prealloc/Kconfig"
source "techpack/wlan/platform/cnss_utils/Kconfig"
source "techpack/wlan/platform/icnss2/Kconfig"
source "techpack/wlan/qcacld-3.0/Kconfig"
source "techpack/touch/Kconfig"
```
